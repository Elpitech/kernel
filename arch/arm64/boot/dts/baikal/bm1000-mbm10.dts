// SPDX-License-Identifier: GPL-2.0
/*
 * Device tree source for MBM 1.0 compatible boards:
 *   - TP-TF307-MB-A0 Rev.1.0 (BM1BM1-A)
 *   - TF307-MB-S-C Rev.3.0
 *
 * Copyright (C) 2021-2023 Baikal Electronics, JSC
 */

/dts-v1/;

#include "bm1000-mbm.dtsi"

/ {
	model = "Baikal Electronics MBM 1.0";
	compatible = "baikal,mbm10", "baikal,bm1000";

	sound {
		simple-audio-card,hp-det-gpio = <&porta 27 GPIO_ACTIVE_HIGH>;
	};
};

&porta {
	gpio-line-names =
		"",		/* GPIO32_0 */
		"PCIE2_PRSNT#",	/* GPIO32_1 */
		"",		/* GPIO32_2 */
		"PCIE2_PERST#",	/* GPIO32_3 */
		"",		/* GPIO32_4 */
		"",		/* GPIO32_5 */
		"PCIE0_PERST#",	/* GPIO32_6 */
		"",		/* GPIO32_7 */
		"LED0",		/* GPIO32_8 */
		"",		/* GPIO32_9 */
		"",		/* GPIO32_10 */
		"",		/* GPIO32_11 */
		"",		/* GPIO32_12 */
		"",		/* GPIO32_13 */
		"",		/* GPIO32_14 */
		"",		/* GPIO32_15 */
		"",		/* GPIO32_16 */
		"LVDS_CLK_EN#", /* GPIO32_17 */
		"HDMI_CLK_EN#",	/* GPIO32_18 */
		"",		/* GPIO32_19 */
		"",		/* GPIO32_20 */
		"",		/* GPIO32_21 */
		"",		/* GPIO32_22 */
		"",		/* GPIO32_23 */
		"",		/* GPIO32_24 */
		"",		/* GPIO32_25 */
		"MIC_DET#",	/* GPIO32_26 */
		"HP_DET",	/* GPIO32_27 */
		"",		/* GPIO32_28 */
		"",		/* GPIO32_29 */
		"",		/* GPIO32_30 */
		"";		/* GPIO32_31 */
};
